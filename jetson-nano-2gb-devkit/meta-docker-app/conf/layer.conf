## jetson-nano-2gb-devkit/meta-docker-app/conf/layer.conf
```bitbake
# We have a conf and classes directory, add to BBPATH
BBPATH .= ":${LAYERDIR}"

# We have recipes-* directories, add to BBFILES
BBFILES += "${LAYERDIR}/recipes-*/*/*.bb \
            ${LAYERDIR}/recipes-*/*/*.bbappend"

BBFILE_COLLECTIONS += "meta-docker-app"
BBFILE_PATTERN_meta-docker-app = "^${LAYERDIR}/"
BBFILE_PRIORITY_meta-docker-app = "6"

LAYERDEPENDS_meta-docker-app = "core"
LAYERSERIES_COMPAT_meta-docker-app = "kirkstone"
```
